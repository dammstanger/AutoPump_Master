
/******************** (C) COPYRIGHT 2016 DammStanger *****************************************
**--------------文件信息----------------------------------------------------------
 * 文件名	：UART_51.c
 * 描	述	：51串口驱动
 *            
 * 实验平台	：自控水泵V2.0
 * 硬件连接	：
 * 版 	本	：V0.1.160122
 * 从属关系	：PoolAuto
 * 库版本	：无
 * 创建时间	：2016.1.22
 * 最后编辑	：2016.1.24
 **-------------------------------------------------------------------------------

 * 作	者	：Damm Stanger
 * 邮	箱	：dammstanger@qq.com
**********************************************************************************************/

/****************************包含头文件*******************************************/
#include "UART_51.h"
#include "globaldefine.h"



/********************************************************************************
 * 函数名：UART_Init()
 * 描述  ：UART1的初始化
 * 输入  ：
 * 返回  ：-
 * 调用  ：-
 ********************************************************************************/
void UART_Init()
{
	TMOD |= 0x20;
	SCON = 0x40;
	TH1 = 0xDC;
	TL1 = TH1;	 	//波特率9600 晶振11.0592MHz		0xFD 115200
	PCON = 0x00;
    ES = 1;
    TR1 = 1;
}


/********************************************************************************
 * 函数名：SendOneByte(unsigned char dat)
 * 描述  ：发送字符串
 * 输入  ：dat
 * 返回  ：-
 * 调用  ：-
 ********************************************************************************/
void SendOneByte(unsigned char dat)
{
	SBUF = dat;
	while(!TI);
	TI = 0;
}

/********************************************************************************
 * 函数名：SendByteASCII(unsigned char dat)
 * 描述  ：发送字节或16进制数的ASCII码
 * 输入  ：dat
 * 返回  ：-
 * 调用  ：-
 ********************************************************************************/
void SendByteASCII(unsigned char dat)
{
	char temp;
	temp = dat>>4;
	if(temp<10)
		SendOneByte(temp+'0');
	else SendOneByte(temp-10+'a');
	temp = dat&0x0f;
		if(temp<10)
		SendOneByte(temp+'0');
	else SendOneByte(temp-10+'a');
}

/********************************************************************************
 * 函数名：SendByteNum(unsigned char dat)
 * 描述  ：发送ASCII码的十进制数
 * 输入  ：dat
 * 返回  ：-
 * 调用  ：-
 ********************************************************************************/
void SendByteNum(unsigned char dat)
{
	SendOneByte(dat+'0');
}
/********************************************************************************
 * 函数名：SendString()
 * 描述  ：发送字符串
 * 输入  ：*str
 * 返回  ：-
 * 调用  ：-
 ********************************************************************************/
void SendString(unsigned char *str)
{
	while(*str!='\0')
	{
		SendOneByte(*str);
		str++;
	}
}

/********************************************************************************
 * 函数名：UART1_SendStr()
 * 描述  ：发送字符串
 * 输入  ：*str   
 * 返回  ：-
 * 调用  ：-
 ********************************************************************************/
void UART1_SendStr(unsigned char len,unsigned char *str)
{
	unsigned char i;
	for(i=0;i<len;i++)
		SendOneByte(str[i]);
}


/********************************************************************************
 * 函数名：SPI_SetSpeed()
 * 描述  ：SPI时钟频率
 * 输入  ：-
 * 返回  ：-
 * 调用  ：-
 ********************************************************************************/
void SerialSIR() interrupt 4
{
	char temp;
	if(RI)
	{	RI = 0;
		EA = 0;
		temp = SBUF;
//		SendOneByte(temp);
		EA = 1;
	}
//	else 
//		TI = 0;			//在发送字符时清除
}


/******************* (C) COPYRIGHT 2016 DammStanger *****END OF FILE************/








