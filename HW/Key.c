/******************** (C) COPYRIGHT 2016 DammStanger *****************************************
**--------------文件信息----------------------------------------------------------
 * 文件名	：Key.c
 * 描	述	：STC 60S2 按键驱动
 *            
 * 实验平台	：自控水泵V2.0
 * 硬件连接	：
 * 版 	本	：V0.1.160216
 * 从属关系	：PoolAuto
 * 库版本	：无
 * 创建时间	：2016.2.16
 * 最后编辑	：2016.2.16
 **-------------------------------------------------------------------------------

 * 作	者	：Damm Stanger
 * 邮	箱	：dammstanger@qq.com
**********************************************************************************************/

/****************************包含头文件*******************************************/
#include "Key.h"
#include "UART_51.h"
#include "Time.h"
/****************************宏定义***********************************************/

/****************************变量定义***********************************************/
sbit k_home = P2^0;
sbit k_enter = P2^2;
sbit k_left = P2^1;
sbit k_right = P2^4;
sbit k_up = P5^0;
sbit k_down = P2^3;




/********************************************************************************
 * 函数名：Key_Scan()
 * 描述  ：按键扫描，一次只读取一个按键值
 * 输入  ：-
 * 返回  ：按键值
 * 调用  ：-
 ********************************************************************************/
char Key_Scan()
{
	if(!(k_home&k_enter&k_right&k_left&k_down&k_up))
	{
		delay100ms();
		if(!(k_home&k_enter&k_right&k_left&k_down&k_up))
		{
			if(!k_home) return KEY_HOME;
			else if(!k_enter) return KEY_ENTER;
			else if(!k_right) return KEY_R;
			else if(!k_left) return KEY_L;
			else if(!k_up) return KEY_UP;
			else if(!k_down) return KEY_DOWN;
		}
		return KEY_NONE;
	}
	return KEY_NONE;
}  
 

/******************* (C) COPYRIGHT 2016 DammStanger *****END OF FILE************/
